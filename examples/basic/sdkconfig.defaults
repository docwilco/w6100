## examples/basic/sdkconfig.defaults
```kconfig
# sdkconfig defaults for W6100 example
CONFIG_IDF_TARGET="esp32s3"

# Enable Ethernet
CONFIG_ETH_ENABLED=y
CONFIG_ETH_USE_SPI_ETHERNET=y

# Increase main task stack for debug output
CONFIG_ESP_MAIN_TASK_STACK_SIZE=4096

# Enable verbose logging during development
CONFIG_LOG_DEFAULT_LEVEL_INFO=y

# Enable FreeRTOS runtime stats for CPU usage tracking
CONFIG_FREERTOS_GENERATE_RUN_TIME_STATS=y
CONFIG_FREERTOS_USE_TRACE_FACILITY=y

# W6100 optimal TCP settings:
# - 12KB window (must stay under 16KB hardware buffer to avoid overflow)
# - recvmbox = TCP_WND/MSS + 2 = 12288/1436 + 2 = 11
CONFIG_LWIP_TCP_WND_DEFAULT=12288
CONFIG_LWIP_TCP_SND_BUF_DEFAULT=12288
CONFIG_LWIP_TCP_RECVMBOX_SIZE=11
```

## examples/iperf/sdkconfig.defaults
```kconfig
# sdkconfig defaults for W6100 iperf example
CONFIG_IDF_TARGET="esp32s3"

# Enable Ethernet
CONFIG_ETH_ENABLED=y
CONFIG_ETH_USE_SPI_ETHERNET=y

# Increase main task stack size for console
CONFIG_ESP_MAIN_TASK_STACK_SIZE=7168

# Enable filesystem for console commands history storage
CONFIG_ESPTOOLPY_FLASHSIZE_4MB=y
CONFIG_PARTITION_TABLE_CUSTOM=y
CONFIG_PARTITION_TABLE_CUSTOM_FILENAME="partitions.csv"
CONFIG_PARTITION_TABLE_FILENAME="partitions.csv"

# Enable FreeRTOS stats formatting functions, needed for 'tasks' command
CONFIG_FREERTOS_USE_TRACE_FACILITY=y
CONFIG_FREERTOS_USE_STATS_FORMATTING_FUNCTIONS=y

# --------------------------------
# Performance optimization options
# --------------------------------
# `lwIP` and `iperf` tasks have serial dependency to each other (i.e. `iperf` must wait for `lwIP`
# to process the packets). Therefore, you don't gain much performance improvement when running
# multi core mode. On the other hand, IRAM optimizations have greater effect for single core mode.

# Run FreeRTOS only on the first core
CONFIG_FREERTOS_UNICORE=y

# Disable watch dog
CONFIG_ESP_INT_WDT=n
CONFIG_ESP_TASK_WDT_EN=n

# Enable lwIP IRAM optimization
CONFIG_LWIP_IRAM_OPTIMIZATION=y

# Enable Ethernet IRAM optimization
CONFIG_ETH_IRAM_OPTIMIZATION=y

# W6100 optimal TCP settings:
# - 12KB window (must stay under 16KB hardware buffer to avoid overflow)
# - recvmbox = TCP_WND/MSS + 2 = 12288/1436 + 2 = 11
CONFIG_LWIP_TCP_WND_DEFAULT=12288
CONFIG_LWIP_TCP_SND_BUF_DEFAULT=12288
CONFIG_LWIP_TCP_RECVMBOX_SIZE=11

# Enable verbose logging during development
CONFIG_LOG_DEFAULT_LEVEL_INFO=y
```

## examples/low_level/sdkconfig.defaults
```kconfig
# ESP32-S3 target
CONFIG_IDF_TARGET="esp32s3"

# Enable Ethernet
CONFIG_ETH_ENABLED=y
CONFIG_ETH_USE_SPI_ETHERNET=y
```
